// SPDX-License-Identifier: GPL-2.0
/*
 * Copyright (C) 2021 - Wolfgang Grandegger <wg@aries-embedded.de>
 */

/dts-v1/;
#include "m100pfsevp.dtsi"

&mssgpio0 {
	sdcard_sel {
		gpio-hog;
		gpios = <12 0>;
		output-high;
	};
};

&sdmmc {
	max-frequency = <50000000>;
	bus-width = <4>;
	no-1-8-v;
	cap-sd-highspeed;
	sd-uhs-sdr12;
	sd-uhs-sdr25;
	sd-uhs-sdr50;
	sd-uhs-sdr104;  
	card-detect-delay = <200>;
	status = "okay";
};
